## CMakeLists.txt
```
cmake_minimum_required(VERSION 3.20.0)

find_package(Zephyr REQUIRED
    PATHS $ENV{ZEPHYR_ENTRY_POINT}
    NO_DEFAULT_PATH
)

project(template)
target_sources(app PRIVATE src/main.c)
```

## prj.conf
```kconfig
# This KConfig file will be detect automatically by Zephyr build system

# example configurations
CONFIG_GPIO=y
CONFIG_PRINTK=y
CONFIG_CONSOLE=y
CONFIG_MULTITHREADING=y
```

## src/main.c
```c
/**
 * Dummy application doing nothing
 */


int main(void) {
	return 0;
}
```
